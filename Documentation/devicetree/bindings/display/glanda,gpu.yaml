## Documentation/devicetree/bindings/display/glanda,gpu.yaml
```yaml
# SPDX-License-Identifier: (GPL-2.0-only OR BSD-2-Clause)
%YAML 1.2
---
$id: http://devicetree.org/schemas/display/glanda,gpu.yaml#
$schema: http://devicetree.org/meta-schemas/core.yaml#

title: GlandaGPU 2D Hardware Accelerated Display Controller

maintainers:
  - Leander Kieweg <kieweg.leander@gmail.com>

description: |
  GlandaGPU is a custom FPGA soft-IP core providing a simple
  2D hardware-accelerated drawing engine (clear/rect/line) with a
  VGA-compatible display output. The register window covers a
  combined VRAM + MMIO region, with MMIO registers at a fixed
  offset within it.

properties:
  compatible:
    const: glanda,gpu-1.0

  reg:
    maxItems: 1
    description:
      Combined VRAM + MMIO register window (VRAM at offset 0,
      MMIO registers at offset 0x00200000 within this range).

  interrupts:
    maxItems: 1

required:
  - compatible
  - reg
  - interrupts

additionalProperties: false

examples:
  - |
    display@c0000000 {
        compatible = "glanda,gpu-1.0";
        reg = <0xc0000000 0x1000000>;
        interrupts = <0 40 4>;
    };
```

## drivers/gpu/drm/glandagpu/Kconfig
```kconfig
config DRM_GLANDA
    tristate "GlandaGPU DRM driver"
    depends on DRM
    select DRM_KMS_HELPER
    select DRM_GEM_SHMEM_HELPER
    help
      DRM/KMS driver for the GlandaGPU hardware-accelerated 2D
      display controller (FPGA soft IP).

config DRM_GLANDA_X86_TEST
    bool "Register a fixed-address test device on x86 (QEMU only)"
    depends on DRM_GLANDA && X86
    default n
    help
      Registers a platform device at a hardcoded physical address
      (0xC0000000) for testing GlandaGPU against a QEMU-based digital
      twin without needing a devicetree.

      WARNING: this blindly ioremaps a fixed physical address range.
      Do NOT enable this on real x86 hardware. This exists solely to
      let reviewers test the driver in QEMU without cross-compiling
      an ARM kernel/rootfs. Leave disabled otherwise.
```

## drivers/misc/scull/Kconfig
```kconfig
config SCULL
    tristate "SCULL: A Simple Character Utility for Locking Localities"
    default m
    help
      This is a sample driver from the book "Linux Device Drivers, 3rd Edition".
      It is a simple character driver that doesn't correspond to any real device.
      If you are unsure, say N.
```
